## firmware/components/bt_config/Kconfig
```kconfig
menu "Butler defaults"

    config BT_LED_BRIGHTNESS_PCT
        int "LED brightness (%)"
        default 10
        range 1 100
        help
            A WS2812 at full brightness is glaring on a desk.

    config BT_WORKING_STALE_S
        int "A working agent that sends nothing for this long is shown as idle (s)"
        default 1800
        range 60 86400
        help
            Claude Code sends no hook when you interrupt it with Esc, so the session would stay "working".
            Too short, and a long build (no hooks while it runs) turns the light idle too early.

    config BT_SESSION_TTL_S
        int "An agent that sends nothing for this long is forgotten (s)"
        default 43200
        range 300 604800
        help
            Covers a terminal closed without SessionEnd (killed, crashed, laptop lid closed).

endmenu
```

## firmware/components/bt_led/Kconfig
```kconfig
menu "Butler status LED"

    config BT_LED_GPIO
        int "GPIO of the WS2812 status LED"
        default 8
        help
            The on-board RGB LED of the ESP32-C6-DevKitC-1 and ESP32-C3-DevKitM-1 is on GPIO8. Check your board's
            schematic for others (README.md, "Other boards").

    config BT_LED_ORDER_RGB
        bool "The LED takes its colours in R-G-B order"
        default y
        help
            A WS2812 takes G-R-B, but the LED on the ESP32-C6-DevKitC-1 boards tested so far takes R-G-B.
            Turn this off if ./bt.sh led-test shows red where it says green.

endmenu
```
